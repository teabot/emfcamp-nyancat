#include <Flash.h>

const int NYAN_WIDTH = 85;
const int NYAN_HEIGHT = 32;
const long NYAN_COLOURS[13] = {
  0x000000,
  0xFF0000,
  0xFFCC99,
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  0xFF9999,
  0x6633FF
};

FLASH_ARRAY(int, NYAN_DATA,
  0, 1, 1, 1, 1, 1, 1, 5, 5, 5, 5, 5, 7, 7, 7, 7, 7, 8, 8, 8, 8, 8, 10, 10, 10, 10, 10, 12, 12, 12, 12, 12,
  0, 1, 1, 1, 1, 1, 1, 5, 5, 5, 5, 5, 7, 7, 7, 7, 7, 8, 8, 8, 8, 8, 10, 10, 10, 10, 10, 12, 12, 12, 12, 12,
  0, 1, 1, 1, 1, 1, 1, 5, 5, 5, 5, 5, 7, 7, 7, 7, 7, 8, 8, 8, 8, 8, 10, 10, 10, 10, 10, 12, 12, 12, 12, 12,
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  0, 0, 0, 0, 0, 0, 0, 0, 0, 0, 0, 0, 0, 0, 0, 6, 6, 6, 6, 6, 11, 11, 11, 11, 0, 0, 0, 0, 0, 0, 0, 0
);

int SDI = 2; //Red wire (not the red 5V wire!)
int CKI = 3; //Green wire
int ledPin = 13; //On board LED
int x = 0;

#define STRIP_LENGTH 32 //32 LEDs on this strip
long strip_colors[STRIP_LENGTH];

void setup() {
  pinMode(SDI, OUTPUT);
  pinMode(CKI, OUTPUT);
  pinMode(ledPin, OUTPUT);

  for(int r = 0 ; r < STRIP_LENGTH ; r++)
    strip_colors[r] = 0;

  //Serial.begin(9600);
  //Serial.println("Hello!");
}

void loop() {
  post_frame(); //Push the current color frame to the strip


  while(1){ //Do nothing
  for(int r = 0 ; r < STRIP_LENGTH ; r++)
    strip_colors[r] = 0;
    post_frame();
    delay(14000);

  for (x = 0; x < NYAN_WIDTH; x++) {
    advance_frame();
    post_frame(); //Push the current color frame to the strip

    digitalWrite(ledPin, HIGH);   // set the LED on
    delay(32);                  // wait for a second
    digitalWrite(ledPin, LOW);    // set the LED off
    delay(32);                  // wait for a second
  }
  }
}

void advance_frame() {
  //First, shuffle all the current colors down one spot on the strip
  for(int y = 0 ; y < NYAN_HEIGHT ; y++) {
    int pixelIndex = (x * NYAN_HEIGHT) + y;
    int colourIndex = NYAN_DATA[pixelIndex];
 //   int colourIndex = pgm_read_word_near(&NYAN_DATA[pixelIndex]);
    strip_colors[y] = NYAN_COLOURS[colourIndex];
    
  }
//Serial.println(x);
  //x++;
  //if (x >= NYAN_WIDTH) {
  //  x = 0;
  //}
}

//Takes the current strip color array and pushes it out
void post_frame (void) {
  //Each LED requires 24 bits of data
  //MSB: R7, R6, R5..., G7, G6..., B7, B6... B0 
  //Once the 24 bits have been delivered, the IC immediately relays these bits to its neighbor
  //Pulling the clock low for 500us or more causes the IC to post the data.

  for(int LED_number = 0 ; LED_number < STRIP_LENGTH ; LED_number++) {
    long this_led_color = strip_colors[LED_number]; //24 bits of color data

    for(byte color_bit = 23 ; color_bit != 255 ; color_bit--) {
      //Feed color bit 23 first (red data MSB)

      digitalWrite(CKI, LOW); //Only change data when clock is low

      long mask = 1L << color_bit;
      //The 1'L' forces the 1 to start as a 32 bit number, otherwise it defaults to 16-bit.

      if(this_led_color & mask) 
        digitalWrite(SDI, HIGH);
      else
        digitalWrite(SDI, LOW);

      digitalWrite(CKI, HIGH); //Data is latched when clock goes high
    }
  }

  //Pull clock low to put strip into reset/post mode
  digitalWrite(CKI, LOW);
  delayMicroseconds(500); //Wait for 500us to go into reset
}

